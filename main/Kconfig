## main/Kconfig
```kconfig
menu "AGV Remote Control"
    menu "Wi-Fi Settings"
        choice AGV_RC_WIFI_AUTHENTICATION
            prompt "Wi-Fi authentication"
            default AGV_RC_WIFI_PASSWORD_AUTHENTICATION

            config AGV_RC_WIFI_PASSWORD_AUTHENTICATION
                bool "Password authentication"
            config AGV_RC_WIFI_WPS_AUTHENTICATION
                bool "WPS authentication"
        endchoice

        menu "Password authentication"
            visible if AGV_RC_WIFI_PASSWORD_AUTHENTICATION

            config AGV_RC_WIFI_SSID
                string "SSID for authentication"
                default "???"
            config AGV_RC_WIFI_PASSWORD
                string "Password for authentication"
                default "???"
        endmenu

        menu "WPS authentication"
            visible if AGV_RC_WIFI_WPS_AUTHENTICATION

            config AGV_RC_WPS_MANUFACTURER
                string "Manufacturer of RC device."
                default "IntemsLab"

            config AGV_RC_WPS_MODEL_NUMBER
                string "Model number (version) of RC device."
                default "1.0"

            config AGV_RC_WPS_MODEL_NAME
                string "Model name (name of version) of RC device."
                default "Prototype"

            config AGV_RC_WPS_DEVICE_NAME
                string "Device name."
                default "AGV Remote Control"
        endmenu
    endmenu

    menu "ROS Settings"
        menu "Topics"
            config AGV_RC_ROS_NAVIGATION_TOPIC_NAME
                string "Navigation topic"
                default "/turtle1/cmd_vel"

            config AGV_RC_ROS_POSITION_TOPIC_NAME
                string "Position topic"
                default "/turtle1/odometry"

            config AGV_RC_ROS_STATUS_TOPIC_NAME
                string "Platform status topic"
                default "/turtle1/status"

            config AGV_RC_ROS_LOG_TOPIC_NAME
                string "Log topic"
                default "/turtle1/log"
        endmenu

        menu "Params"
            config AGV_RC_ROS_PLATFORM_NAME_PARAM
                string "Platform name param."
                default "/agv_remote_control/platform_name"

            config AGV_RC_ROS_MAX_LINEAR_SPEED_PARAM
                string "Linear speed param."
                default "/agv_remote_control/max_linear_speed"

            config AGV_RC_ROS_MAX_ANGULAR_SPEED_PARAM
                string "Angular speed param."
                default "/agv_remote_control/max_angular_speed"
        endmenu
    endmenu
endmenu
```
